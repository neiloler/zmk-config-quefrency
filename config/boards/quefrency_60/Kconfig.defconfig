## config/boards/quefrency_60/Kconfig.defconfig
```kconfig
# Copyright (c) 2020 The ZMK Contributors
# SPDX-License-Identifier: MIT
 
 
if SHIELD_QUEFRENCY_60_LEFT

config ZMK_KEYBOARD_NAME
	default "Quefrency 60% left"

config ZMK_SPLIT_BLE_ROLE_CENTRAL
	default y

endif

if SHIELD_QUEFRENCY_60_RIGHT

config ZMK_KEYBOARD_NAME
	default "Quefrency 60% right"

endif

if SHIELD_QUEFRENCY_LEFT || SHIELD_QUEFRENCY_RIGHT

config ZMK_SPLIT
	default y

endif
```

## config/boards/quefrency_60/Kconfig.shield
```kconfig
# Copyright (c) 2020 The ZMK Contributors
# SPDX-License-Identifier: MIT

config SHIELD_QUEFRENCY_60_LEFT
	def_bool $(shields_list_contains,quefrency_60_left)

config SHIELD_QUEFRENCY_60_RIGHT
	def_bool $(shields_list_contains,quefrency_60_right)
```

## config/boards/shields/quefrency_60/Kconfig.defconfig
```kconfig
# Copyright (c) 2020 The ZMK Contributors
# SPDX-License-Identifier: MIT

CONFIG_ZMK_USB_LOGGING=y

if SHIELD_QUEFRENCY_60_LEFT

config ZMK_KEYBOARD_NAME
	default "Quefrency60%"

config ZMK_SPLIT_BLE_ROLE_CENTRAL
	default y

endif

if SHIELD_QUEFRENCY_60_LEFT || SHIELD_QUEFRENCY_60_RIGHT

config ZMK_SPLIT
	default y

endif
```
